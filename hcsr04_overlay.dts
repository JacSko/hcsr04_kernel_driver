/dts-v1/;
/plugin/;
/ {
	compatible = "brcm,bcm2835";
	fragment@0 {
		target-path = "/";
		__overlay__ {
			my_device {
				compatible = "jskowronek,hcsr04";
				status = "okay";
				label = "sensor1";
				echo-gpio = <&gpio 21 0>;
				trigger-gpio = <&gpio 20 0>;
			};
			my_device2 {
				compatible = "jskowronek,hcsr04";
				status = "okay";
				label = "sensor2";
				echo-gpio = <&gpio 23 0>;
				trigger-gpio = <&gpio 24 0>;
			};
		};
	};
};
